#include "wled.h"
#include "FX.h"
#include "fontmanager.h"
#include "glowtext_plus/glowtext_plus.h"

// AI: below section was generated by an AI
// GlowText+ : text taken from the segment name, letters revealed one by one,
// drawn with a soft glow (same text drawn at 8 neighbour offsets in colour 2).
//
// Controls:
//   Speed (sx)     -> horizontal scroll speed (only when text is wider than the segment)
//   Glow (ix)      -> glow brightness
//   Reveal (c1)    -> letter reveal speed (higher = faster)
//   Font (c2)      -> built-in font 0..4
// Colors: 1 = text, 2 = glow

// ===================== GlowText+ UI JSON =====================
const char JSON_GLOWTEXTPLUS[] PROGMEM = R"json({
  "text": {
    "name": "Text",
    "type": "text",
    "default": "Hello World"
  },
  "textColor": {
    "name": "Text Color",
    "type": "color"
  },
  "glowColor": {
    "name": "Glow Color",
    "type": "color"
  },
  "glowStrength": {
    "name": "Glow Strength",
    "type": "slider",
    "min": 0,
    "max": 255,
    "default": 80
  },
  "outlineStrength": {
    "name": "Outline Strength",
    "type": "slider",
    "min": 0,
    "max": 255,
    "default": 40
  },
  "scrollSpeed": {
    "name": "Scroll Speed",
    "type": "slider",
    "min": 0,
    "max": 255,
    "default": 60
  },
  "scrollDir": {
    "name": "Scroll Direction",
    "type": "select",
    "options": ["Left", "Right"],
    "default": "Left"
  },
  "fontIndex": {
    "name": "Font",
    "type": "select",
    "options": ["0","1","2","3"],
    "default": "0"
  },
  "lineSpacing": {
    "name": "Line Spacing",
    "type": "slider",
    "min": 0,
    "max": 20,
    "default": 4
  },
  "fadeTime": {
    "name": "Fade Time",
    "type": "slider",
    "min": 0,
    "max": 2000,
    "default": 300
  },
  "bgDim": {
    "name": "Background Dim",
    "type": "slider",
    "min": 0,
    "max": 255,
    "default": 20
  }
})json";


void mode_glowtextplus(void) {
  if (!strip.isMatrix || !SEGMENT.is2D()) { SEGMENT.fill(BLACK); return; }

  const int cols = SEG_W;
  const int rows = SEG_H;

  char text[WLED_MAX_SEGNAME_LEN + 1] = {'\0'};
  if (SEGMENT.name && SEGMENT.name[0]) strlcpy(text, SEGMENT.name, sizeof(text));
  else strlcpy(text, "Hello World", sizeof(text));

  FontManager fontManager(&SEGMENT);
  uint8_t fontNum = map(SEGMENT.custom2, 0, 255, 0, 4);
  if (!fontManager.loadFont(fontNum, text, false)) return;

  const int fontHeight = fontManager.getFontHeight();
  const int spacing = fontManager.getFontSpacing();
  const int numChars = utf8_strlen(text);

  // total width of the whole text
  int totalWidth = 0;
  int idx = 0;
  for (int c = 0; c < numChars; c++) {
    uint8_t len;
    uint32_t u = utf8_decode(&text[idx], &len);
    idx += len;
    totalWidth += fontManager.getGlyphWidth(u) + spacing;
  }
  totalWidth -= spacing;

  // step: aux0 = scroll offset, aux1 = revealed characters (x16 for sub-steps)
  if (SEGENV.call == 0) { SEGENV.aux0 = 0; SEGENV.aux1 = 0; SEGENV.step = 0; }
  if (SEGENV.step < strip.now) {
    uint16_t revealStep = map(SEGMENT.custom1, 0, 255, 600, 40);
    if (SEGENV.aux1 < numChars) SEGENV.aux1++;
    else if (totalWidth > cols) SEGENV.aux0 = (SEGENV.aux0 + 1) % (totalWidth + cols);
    SEGENV.step = strip.now + (SEGENV.aux1 < numChars ? revealStep : map(SEGMENT.speed, 0, 255, 150, 20));
  }

  SEGMENT.fill(BLACK);

  const uint32_t textCol = SEGCOLOR(0);
  const uint32_t glowCol = color_fade(SEGCOLOR(1), SEGMENT.intensity, true);
  const int y = (rows - fontHeight) / 2;
  const int startX = (totalWidth > cols && SEGENV.aux1 >= numChars) ? cols - (int)SEGENV.aux0 : (cols - totalWidth) / 2;

  // two passes: glow first, then text on top
  for (int pass = 0; pass < 2; pass++) {
    int x = startX;
    idx = 0;
    for (int c = 0; c < (int)SEGENV.aux1 && c < numChars; c++) {
      uint8_t len;
      uint32_t u = utf8_decode(&text[idx], &len);
      idx += len;
      int w = fontManager.getGlyphWidth(u);
      if (x < cols && x + w >= -1) {
        if (pass == 0) {
          for (int dx = -1; dx <= 1; dx++)
            for (int dy = -1; dy <= 1; dy++)
              if (dx || dy) fontManager.drawCharacter(u, x + dx, y + dy, glowCol, glowCol, 0);
        } else {
          fontManager.drawCharacter(u, x, y, textCol, textCol, 0);
        }
      }
      x += w + spacing;
    }
  }
}
// AI: end
